

flash.reprogram ALL
data.load.binary * E:0x60000--0x7FFFF
flash.reprogram OFF




